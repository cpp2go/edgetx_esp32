## radio/src/targets/openx1/esp32_build/sdkconfig.defaults
```kconfig
# EdgeTX OpenX1 common settings (all ESP targets)

CONFIG_ESPTOOLPY_FLASHSIZE_16MB=y
CONFIG_PARTITION_TABLE_CUSTOM=y
CONFIG_PARTITION_TABLE_CUSTOM_FILENAME="partitions.csv"

CONFIG_FREERTOS_HZ=1000
CONFIG_ESP_MAIN_TASK_STACK_SIZE=3584

# OpenX1 display (ILI9488 MCU 8-bit)
CONFIG_LV_PREDEFINED_DISPLAY_OPENX1=y
CONFIG_LV_TFT_DISPLAY_CONTROLLER_ILI9488=y
CONFIG_LV_TFT_DISPLAY_PROTOCOL_MCU=y
CONFIG_LV_TFT_MCU_BUS_WIDTH_8=y
CONFIG_LV_TFT_MCU_RST_NUM=-1
CONFIG_LV_TFT_MCU_CS_NUM=3
CONFIG_LV_TFT_MCU_DC_NUM=46
CONFIG_LV_TFT_MCU_WR_NUM=9
CONFIG_LV_TFT_MCU_DATA0=10
CONFIG_LV_TFT_MCU_DATA1=11
CONFIG_LV_TFT_MCU_DATA2=12
CONFIG_LV_TFT_MCU_DATA3=13
CONFIG_LV_TFT_MCU_DATA4=14
CONFIG_LV_TFT_MCU_DATA5=21
CONFIG_LV_TFT_MCU_DATA6=47
CONFIG_LV_TFT_MCU_DATA7=48
CONFIG_LV_DISPLAY_ORIENTATION_LANDSCAPE=y
CONFIG_LV_DISPLAY_ORIENTATION=2
CONFIG_LV_DISP_BACKLIGHT_SWITCH=y
CONFIG_LV_BACKLIGHT_ACTIVE_LVL=y
CONFIG_LV_DISP_PIN_BCKL=45

# Touch (FT6x06 over I2C)
CONFIG_LV_TOUCH_CONTROLLER_FT6X06=y
CONFIG_LV_I2C_TOUCH=y
CONFIG_LV_FT6X36_SWAPXY=y
CONFIG_LV_FT6X36_INVERT_Y=y
CONFIG_LV_I2C=y

# NimBLE (WiFi/BT stack on native targets; on P4 via esp_hosted C6)
CONFIG_BT_ENABLED=y
CONFIG_BT_NIMBLE_ENABLED=y
CONFIG_BT_NIMBLE_MEM_ALLOC_MODE_EXTERNAL=y
CONFIG_BT_NIMBLE_ROLE_CENTRAL=y
CONFIG_BT_NIMBLE_ROLE_OBSERVER=y
CONFIG_BT_NIMBLE_GATT_CLIENT=y
CONFIG_BT_NIMBLE_MAX_CONNECTIONS=3
```

## radio/src/targets/openx1/esp32_build/sdkconfig.defaults.esp32s3
```kconfig
# ESP32-S3: native WiFi + Bluetooth

CONFIG_ESP32S3_SPIRAM_SUPPORT=y
CONFIG_SPIRAM=y
CONFIG_SPIRAM_MODE_OCT=y
CONFIG_SPIRAM_TYPE_AUTO=y
CONFIG_SPIRAM_SPEED_80M=y
CONFIG_SPIRAM_FETCH_INSTRUCTIONS=y
CONFIG_SPIRAM_RODATA=y
CONFIG_SPIRAM_USE_MALLOC=y
CONFIG_SPIRAM_MALLOC_ALWAYSINTERNAL=0
CONFIG_SPIRAM_TRY_ALLOCATE_WIFI_LWIP=y
CONFIG_SPIRAM_MALLOC_RESERVE_INTERNAL=131072
CONFIG_SPIRAM_ALLOW_BSS_SEG_EXTERNAL_MEMORY=y

CONFIG_BT_CONTROLLER_ENABLED=y
CONFIG_ESP_WIFI_ENABLED=y
```
